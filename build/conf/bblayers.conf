## build/conf/bblayers.conf
```bitbake
# POKY_BBLAYERS_CONF_VERSION is increased each time build/conf/bblayers.conf
# changes incompatibly
POKY_BBLAYERS_CONF_VERSION = "2"

BBPATH = "${TOPDIR}"
BBFILES ?= ""

BBLAYERS ?= " \
  /home/sasy/Desktop/TestCam/poky/meta \
  /home/sasy/Desktop/TestCam/poky/meta-poky \
  /home/sasy/Desktop/TestCam/poky/meta-yocto-bsp \
  /home/sasy/Desktop/TestCam/meta-openembedded/meta-oe \
  /home/sasy/Desktop/TestCam/meta-openembedded/meta-python \
  /home/sasy/Desktop/TestCam/meta-openembedded/meta-multimedia \
  /home/sasy/Desktop/TestCam/meta-raspberrypi \
  /home/sasy/Desktop/TestCam/meta-camera \
  "
```
